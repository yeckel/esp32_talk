## sdkconfig.defaults
```kconfig
# ── Bluetooth ───────────────────────────────────────────────
CONFIG_BT_ENABLED=y
CONFIG_BT_BLE_ENABLED=n
CONFIG_BTDM_CTRL_MODE_BR_EDR_ONLY=y
CONFIG_BTDM_CTRL_BR_EDR_MAX_ACL_CONN=2
CONFIG_BTDM_CTRL_BR_EDR_MAX_SYNC_CONN=1
CONFIG_BT_BLUEDROID_ENABLED=y
CONFIG_BT_CLASSIC_ENABLED=y
CONFIG_BT_HFP_ENABLE=y
CONFIG_BT_HFP_AG_ENABLE=y
CONFIG_BT_HFP_CLIENT_ENABLE=n
CONFIG_BT_HFP_AUDIO_DATA_PATH_HCI=y
CONFIG_BTDM_CTRL_BR_EDR_SCO_DATA_PATH_HCI=y
CONFIG_BT_A2DP_ENABLE=n
CONFIG_BT_SPP_ENABLED=n
CONFIG_BT_HID_ENABLED=n
CONFIG_BT_ACL_CONNECTIONS=2
CONFIG_BT_ALLOCATION_FROM_SPIRAM_FIRST=n
CONFIG_BT_BLE_DYNAMIC_ENV_MEMORY=n

# ── Partition table ────────────────────────────────────────
CONFIG_PARTITION_TABLE_CUSTOM=y
CONFIG_PARTITION_TABLE_CUSTOM_FILENAME="partitions.csv"

# ── FreeRTOS / main task ───────────────────────────────────
CONFIG_ESP_MAIN_TASK_STACK_SIZE=6144

# ── Compiler: size-optimised → smaller .text → more free heap ──
CONFIG_COMPILER_OPTIMIZATION_SIZE=y

# ── WiFi – ESP-NOW needs very few buffers ──────────────────
CONFIG_ESP_WIFI_STATIC_RX_BUFFER_NUM=4
CONFIG_ESP_WIFI_DYNAMIC_RX_BUFFER_NUM=8
CONFIG_ESP_WIFI_DYNAMIC_TX_BUFFER_NUM=8
CONFIG_ESP_WIFI_AMPDU_TX_ENABLED=n
CONFIG_ESP_WIFI_AMPDU_RX_ENABLED=n
CONFIG_ESP_WIFI_RX_MGMT_BUF_NUM_DEF=2
CONFIG_ESP_WIFI_NVS_ENABLED=n
CONFIG_ESP_WIFI_SOFTAP_SUPPORT=n
CONFIG_ESP_WIFI_MGMT_SBUF_NUM=8
CONFIG_ESP_WIFI_ENABLE_WPA3_SAE=n
CONFIG_ESP_WIFI_ENABLE_WPA3_OWE_STA=n

# ── LWIP – we use ESP-NOW (no TCP/IP) ─────────────────────
CONFIG_LWIP_MAX_SOCKETS=4
CONFIG_LWIP_MAX_ACTIVE_TCP=2
CONFIG_LWIP_TCP_SND_BUF_DEFAULT=2880
CONFIG_LWIP_TCP_WND_DEFAULT=2880
CONFIG_LWIP_TCPIP_RECVMBOX_SIZE=8
CONFIG_LWIP_IPV6=n
CONFIG_LWIP_DHCPS=n

# ── mbedTLS – we don't use TLS/HTTPS ──────────────────────
CONFIG_MBEDTLS_TLS_DISABLED=y
CONFIG_MBEDTLS_CERTIFICATE_BUNDLE=n

# ── HTTP – not used ───────────────────────────────────────
CONFIG_ESP_HTTP_CLIENT_ENABLE_HTTPS=n

# ── Log level ─────────────────────────────────────────────
CONFIG_LOG_DEFAULT_LEVEL_INFO=y
```
